## conf/local.conf
```bitbake
app.type = "prod"

app.ckan.url = "http://ckan:5000"
security.manager.host = "http://localhost:9002"
app.local.url = "http://localhost:9000"

catalog.file.path="/data/Catalog.json"
distribution.file.path="/data/Distribution.json"
brokenlink.file.path="data/BrokenLink.json"

metabase.url= "http://metabase:3000"
metabase.user = "admin@admin.it"
metabase.pass = "admin01"

superset.url="http://supersetd:8088"
superset.user = "superadmin"
superset.pass = "passowrd1"

pac4j.jwt_secret = "123456789012345678901234567890123"
pac4j.security {
  rules = [
    {
      "/dati-gov/v1/user-stories.*" = {
        authorizers = "_authenticated_"
        clients = "DirectBasicAuthClient, HeaderClient"
      }
    },
    {
      "/dati-gov/v1/public/.*" = {
        authorizers = "_anonymous_"
      }
    },
    {
      "/dati-gov/v1/settings/.*" = {
        authorizers = "_authenticated_"
        clients = "DirectBasicAuthClient, HeaderClient"
      }
    },
    {
      "/dati-gov/v1/settings.*" = {
        authorizers = "_anonymous_"
      }
    },
    {
      "/dati-gov/v1/dashboard/tables.*" = {
        authorizers = "_anonymous_"
      }
    },
    {
      "/dati-gov/v1/dashboard/iframes.*" = {
        authorizers = "_authenticated_"
        clients = "DirectBasicAuthClient, HeaderClient"
      }
    },
    {
      "/dati-gov/v1/dashboards.*" = {
        authorizers = "_authenticated_"
        clients = "DirectBasicAuthClient, HeaderClient"
      }

    },
    {
      "/dati-gov/v1/domain.*" = {
        authorizers = "_authenticated_"
        clients = "DirectBasicAuthClient, HeaderClient"
      }
    },
    {
      "/dati-gov/v1/save/.*" = {
        authorizers = "_authenticated_"
        clients = "DirectBasicAuthClient, HeaderClient"
      }
    },
    {
      "/dati-gov/v1/delelte/.*" = {
        authorizers = "_authenticated_"
        clients = "DirectBasicAuthClient, HeaderClient"
      }
    },
    {
      "/dati-gov/v1/dashboard/.*" = {
        authorizers = "_authenticated_"
        clients = "DirectBasicAuthClient, HeaderClient"
      }
    },
    {
      "/dati-gov/v1/plot/.*" = {
        authorizers = "_anonymous_"
      }
    },
    {
      "/dati-gov/v1/.*" = {
        authorizers = "_authenticated_"
        clients = "DirectBasicAuthClient, HeaderClient"
      }
    }
  ]
}
##
grafana.apiKey = xx
grafana.url=xx
##

val URL = conf.getString("grafana.url").get
// TMP for test purpose
val apiKey = conf.getString("grafana.apiKey").get

val local = conf.getString("app.local.url").get
pac4j.authenticator = "ldap"
pac4j.ldap.url = "ldap://ipa.example.test:636"
pac4j.ldap.base_user_dn = "cn=users,cn=accounts,dc=example,dc=test"
pac4j.ldap.login_attribute = "mail"
pac4j.ldap.username_attribute = "uid"
pac4j.ldap.bind_dn =  "uid=admin,cn=users,cn=accounts,dc=example,dc=test"
pac4j.ldap.bind_pwd = "adminpassword"


play.http.parser.maxMemoryBuffer = 256K
play.http.parser.maxDiskBuffer=25MB


# This is the main configuration file for the application.
# ~~~~~

# Secret key
# ~~~~~
# The secret key is used to secure cryptographics functions.
#
# This must be changed for production, but we recommend not changing it in this file.
#
# See http://www.playframework.com/documentation/latest/ApplicationSecret for more details.
play.crypto.secret = "changeme"

# The application languages
# ~~~~~
play.i18n.langs = [ "en" ]

play.filters.cors {
  allowedHttpMethods = ["GET", "POST", "HEAD", "DELETE", "PUT", "PATCH" ]
}
```
